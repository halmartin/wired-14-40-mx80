## openwrt/package/blescan/Config.in
```kconfig
config BR2_PACKAGE_BLESCAN
	prompt "BLESCAN.............................. A file to scan bluetooth LE"
	tristate
	default n if CONFIG_DEVEL
	help
		A small utility to spit out bluetooth low energy advertisements
```

## openwrt/package/bluez-lite/Config.in
```kconfig
config BR2_PACKAGE_BLUEZ_LITE
  prompt "bluezlite....................... Bluez library... lite"
  tristate
  default n if CONFIG_DEVEL
  help
    Small library of Bluez
```

## openwrt/package/hciconfigle/Config.in
```kconfig
config BR2_PACKAGE_HCICONFIGLE
  prompt "HCICONFIGLE......................... hciconfig for bluetooth LE"
	tristate
	default n if CONFIG_DEVEL
	help
	  A small utility for configuring LE
```
